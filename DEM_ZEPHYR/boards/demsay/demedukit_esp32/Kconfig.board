## DEM_ZEPHYR/boards/demsay/demedukit_esp32/Kconfig.board
```kconfig
# SPDX-License-Identifier: Apache-2.0

config BOARD_DEMEDUKIT_ESP32
bool "DemeduKit ESP32"
depends on SOC_SERIES_ESP32
```

## DEM_ZEPHYR/boards/demsay/demedukit_esp32/Kconfig.defconfig
```kconfig
# SPDX-License-Identifier: Apache-2.0

if BOARD_DEMEDUKIT_ESP32

config BOARD
default "demedukit_esp32"

endif # BOARD_DEMEDUKIT_ESP32
```

## DEM_ZEPHYR/boards/demsay/demedukit_esp32/Kconfig.demedukit_esp32
```kconfig
# SPDX-License-Identifier: Apache-2.0

config BOARD_DEMEDUKIT_ESP32
bool "DemeduKit ESP32"
select SOC_ESP32
```

## DEM_ZEPHYR/boards/demsay/demedukit_esp32/board.yml
```yaml
board:
  name: demedukit_esp32
  full_name: DemeduKit ESP32
  vendor: demsay
  socs:
  - name: esp32
```

## DEM_ZEPHYR/boards/demsay/demedukit_esp32/demedukit_esp32_appcpu_defconfig
```kconfig
CONFIG_SOC_SERIES_ESP32=y
CONFIG_SOC_ESP32=y
CONFIG_BOARD_DEMEDUKIT_ESP32=y
CONFIG_IPM=y
```

## DEM_ZEPHYR/boards/demsay/demedukit_stm32/Kconfig.board
```kconfig
config BOARD_DEMEDUKIT_STM32
bool "DemeduKit STM32G030 Board"
depends on SOC_STM32G030XX
```

## DEM_ZEPHYR/boards/demsay/demedukit_stm32/Kconfig.defconfig
```kconfig
if BOARD_DEMEDUKIT_STM32
config BOARD
default "demedukit_stm32"
config SOC_STM32G030XX
default y
endif
```

## DEM_ZEPHYR/build/Kconfig/boards/Kconfig.defconfig
```kconfig
# Load Zephyr board defconfig descriptions.
osource "C:/zephyrproject/DEM_ZEPHYR/boards/demsay/demedukit_esp32/Kconfig.defconfig"
```

## DEM_ZEPHYR/build/Kconfig/boards/Kconfig.demedukit_esp32
```kconfig
# Load board Kconfig descriptions.
osource "C:/zephyrproject/DEM_ZEPHYR/boards/demsay/demedukit_esp32/Kconfig.demedukit_esp32"
```

## DEM_ZEPHYR/build/Kconfig/boards/Kconfig.sysbuild
```kconfig
# Load Sysbuild board Kconfig descriptions.
osource "C:/zephyrproject/DEM_ZEPHYR/boards/demsay/demedukit_esp32/Kconfig.sysbuild"
```

## DEM_ZEPHYR/build/Kconfig/boards/Kconfig.tmp
```kconfig
# Load Zephyr board Kconfig descriptions.
osource "C:/zephyrproject/DEM_ZEPHYR/boards/demsay/demedukit_esp32/Kconfig"
```
